## app/boards/arm/nice_nano_v2/nice_nano_v2_defconfig
```kconfig
CONFIG_SOC_SERIES_NRF52X=y
CONFIG_SOC_NRF52840=y
CONFIG_SOC_NRF52840_QIAA=y

CONFIG_BOARD_NICE_NANO_V2=y

CONFIG_GPIO=y
CONFIG_SERIAL=y
CONFIG_UART_INTERRUPT_DRIVEN=y
CONFIG_UART_NRFX=y
CONFIG_BT=y
CONFIG_BT_PERIPHERAL=y
CONFIG_BT_DEVICE_NAME="nice!nano"
CONFIG_BT_DEVICE_APPEARANCE=0

CONFIG_FLASH=y
CONFIG_FLASH_PAGE_LAYOUT=y
CONFIG_MCUBOOT_BOOTLOADER_MODE_SWAP_USING_MOVE=y
CONFIG_BOOTLOADER_MCUBOOT=y
```

## boards/shields/ble_fixture/Kconfig.defconfig
```kconfig
# Copyright (c) 2026 The ZMK Contributors
# SPDX-License-Identifier: MIT

if SHIELD_BLE_FIXTURE

config ZMK_KEYBOARD_NAME
    default "Nordic_Blinky"

endif
```

## boards/shields/ble_fixture/Kconfig.shield
```kconfig
# Copyright (c) 2026 The ZMK Contributors
# SPDX-License-Identifier: MIT

config SHIELD_BLE_FIXTURE
    def_bool $(shields_list_contains,ble_fixture)
```

## config/boards/arm/nice_nano/Kconfig.defconfig
```kconfig
# Copyright (c) 2021 The ZMK Contributors
# SPDX-License-Identifier: MIT

if BOARD_NICE_NANO || BOARD_NICE_NANO_V2

config BOARD
	default "nice_nano"

if USB_DEVICE_STACK

config USB_NRFX
	default y

endif

config BT_CTLR
	default BT

endif
```

## config/boards/arm/nice_nano/nice_nano_defconfig
```kconfig
# SPDX-License-Identifier: MIT

CONFIG_SOC_SERIES_NRF52X=y
CONFIG_SOC_NRF52840_QIAA=y
CONFIG_BOARD_NICE_NANO=y

CONFIG_ARM_MPU=y
CONFIG_GPIO=y
CONFIG_PINCTRL=y

CONFIG_USE_DT_CODE_PARTITION=y
CONFIG_BUILD_OUTPUT_UF2=y
CONFIG_MPU_ALLOW_FLASH_WRITE=y
```
